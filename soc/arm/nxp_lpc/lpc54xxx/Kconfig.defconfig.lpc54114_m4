## soc/arm/nxp_lpc/lpc54xxx/Kconfig.defconfig.lpc54114_m4
```kconfig
# NXP LPC54114 platform configuration options

# Copyright (c) 2017, NXP
# SPDX-License-Identifier: Apache-2.0

if SOC_LPC54114_M4

config SOC
	default "lpc54114"

choice USB_MCUX_CONTROLLER_TYPE
	default USB_DC_NXP_LPCIP3511
endchoice

endif # SOC_LPC54114_M4
```
